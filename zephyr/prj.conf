## CMakeLists.txt
```
cmake_minimum_required(VERSION 3.20.0)

find_package(Zephyr REQUIRED HINTS $ENV{ZEPHYR_BASE})
project(pico_router_sample)

target_sources(app PRIVATE
  src/main.cpp
  ${CMAKE_CURRENT_SOURCE_DIR}/../src/pathfind/astar.cpp
  ${CMAKE_CURRENT_SOURCE_DIR}/../src/fixtures/static_mock_graphs.cpp
)

target_compile_options(app PRIVATE
  -fno-threadsafe-statics
)

target_include_directories(app PRIVATE
  ${CMAKE_CURRENT_SOURCE_DIR}/../include
)
```

## prj.conf
```kconfig
CONFIG_MAIN_STACK_SIZE=8192
CONFIG_PRINTK=y
CONFIG_CONSOLE=y
CONFIG_UART_CONSOLE=y
```

## src/main.cpp
```c
#include <zephyr/kernel.h>
#include <zephyr/sys/printk.h>

#include "fixtures/static_mock_graphs.hpp"
#include "pathfind/astar.hpp"

int main() {
  printk("=== APP STARTED ===\n");

  pathfind::Graph graph =
      pathfind::createMockGraph(pathfind::MockGraphType::GRID_5X5);

  pathfind::Astar planner;
  const auto path = planner.calculatePath(graph, 0, 24);

  printk("Path: ");

  for (size_t index = 0; index < path.length; ++index) {
    printk("%u ", static_cast<unsigned int>(path.nodes[index]));
  }

  printk("\n");
  printk("=== APP FINISHED ===\n");

  while (true) {
    k_sleep(K_SECONDS(1));
  }
}
```
